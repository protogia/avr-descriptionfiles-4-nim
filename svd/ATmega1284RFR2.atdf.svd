# ATmega1284RFR2 register map
Vendor: Atmel; File version: 1.0
CPU: other r0p0, little endian, no MPU, no FPU, 4 interrupt priority bits
Registers are 8-bit, read-write, reset 0x0 unless marked. A register's access mark holds for its fields unless they carry their own. Offsets are from the block's base; lines under a group give offsets from that group; [hi:lo] are bit positions; {n}, {i} and the like mark numbered series; 'fields as' and 'values as' point back to an identical list; <NAME> marks a mode.

## Memory map
0x00000000 FUSE size 0x3 — Fuses
0x00000000 LOCKBIT size 0x1 — Lockbits
0x00000020 PORTA size 0x3 — I/O Port
0x00000023 PORTB size 0x3 — I/O Port
0x00000026 PORTC size 0x3 — I/O Port
0x00000029 PORTD size 0x3 — I/O Port
0x0000002C PORTE size 0x3 — I/O Port
0x0000002F PORTF size 0x3 — I/O Port
0x00000032 PORTG size 0x3 — I/O Port
0x00000035 TC0 blocks up to offset 0x3A — Timer/Counter, 8-bit
0x00000036 TC1 blocks up to offset 0x58 — Timer/Counter, 16-bit
0x00000037 TC2 blocks up to offset 0x80 — Timer/Counter, 8-bit Async
0x00000038 TC3 blocks up to offset 0x66 — Timer/Counter, 16-bit
0x00000039 TC4 blocks up to offset 0x75 — Timer/Counter, 16-bit
0x0000003A TC5 blocks up to offset 0xF4 — Timer/Counter, 16-bit
0x0000003B EXINT blocks up to offset 0x33 — External Interrupts
0x0000003E CPU blocks up to offset 0x29 — CPU Registers
0x0000003F EEPROM size 0x4
0x0000004C SPI size 0x3 — Serial Peripheral Interface
0x00000050 AC blocks up to offset 0x30 — Analog Comparator
0x00000051 JTAG blocks up to offset 0x5 — JTAG Interface
0x00000055 PWRCTRL blocks up to offset 0xE5 — Power Controller
0x00000057 BOOT_LOAD size 0x1 — Bootloader
0x00000060 WDT size 0x1 — Watchdog Timer
0x00000067 FLASH blocks up to offset 0xF — FLASH Controller
0x00000077 ADC size 0x8 — Analog-to-Digital Converter
0x000000B8 TWI size 0x6 — Two Wire Serial Interface
0x000000BE TRX24 blocks up to offset 0x142 — Low-Power 2.4 GHz Transceiver
0x000000C0 USART0 blocks up to offset 0x7 — USART
0x000000C0 USART0_SPI size 0x3 — Serial Peripheral Interface
0x000000C8 USART1 blocks up to offset 0x7 — USART
0x000000C8 USART1_SPI size 0x3 — Serial Peripheral Interface
0x000000D7 SYMCNT size 0x26 — MAC Symbol Counter

## Interrupts
0 RESET (CPU) — External Pin,Power-on Reset,Brown-out Reset,Watchdog Reset,and JTAG AVR Reset. See Datasheet.
{n+1} INT{n} (CPU) (n=0..7) — External Interrupt Request {n}
9 PCINT0 (CPU) — Pin Change Interrupt Request 0
10 PCINT1 (CPU) — Pin Change Interrupt Request 1
11 PCINT2 (CPU) — Pin Change Interrupt Request 2
12 WDT (CPU) — Watchdog Time-out Interrupt
13 TIMER2_COMPA (CPU) — Timer/Counter2 Compare Match A
14 TIMER2_COMPB (CPU) — Timer/Counter2 Compare Match B
15 TIMER2_OVF (CPU) — Timer/Counter2 Overflow
16 TIMER1_CAPT (CPU) — Timer/Counter1 Capture Event
17 TIMER1_COMPA (CPU) — Timer/Counter1 Compare Match A
18 TIMER1_COMPB (CPU) — Timer/Counter1 Compare Match B
19 TIMER1_COMPC (CPU) — Timer/Counter1 Compare Match C
20 TIMER1_OVF (CPU) — Timer/Counter1 Overflow
21 TIMER0_COMPA (CPU) — Timer/Counter0 Compare Match A
22 TIMER0_COMPB (CPU) — Timer/Counter0 Compare Match B
23 TIMER0_OVF (CPU) — Timer/Counter0 Overflow
24 SPI_STC (CPU) — SPI Serial Transfer Complete
25 USART0_RX (CPU) — USART0, Rx Complete
26 USART0_UDRE (CPU) — USART0 Data register Empty
27 USART0_TX (CPU) — USART0, Tx Complete
28 ANALOG_COMP (CPU) — Analog Comparator
29 ADC (CPU) — ADC Conversion Complete
30 EE_READY (CPU) — EEPROM Ready
31 TIMER3_CAPT (CPU) — Timer/Counter3 Capture Event
32 TIMER3_COMPA (CPU) — Timer/Counter3 Compare Match A
33 TIMER3_COMPB (CPU) — Timer/Counter3 Compare Match B
34 TIMER3_COMPC (CPU) — Timer/Counter3 Compare Match C
35 TIMER3_OVF (CPU) — Timer/Counter3 Overflow
36 USART1_RX (CPU) — USART1, Rx Complete
37 USART1_UDRE (CPU) — USART1 Data register Empty
38 USART1_TX (CPU) — USART1, Tx Complete
39 TWI (CPU) — 2-wire Serial Interface
40 SPM_READY (CPU) — Store Program Memory Read
41 TIMER4_CAPT (CPU) — Timer/Counter4 Capture Event
42 TIMER4_COMPA (CPU) — Timer/Counter4 Compare Match A
43 TIMER4_COMPB (CPU) — Timer/Counter4 Compare Match B
44 TIMER4_COMPC (CPU) — Timer/Counter4 Compare Match C
45 TIMER4_OVF (CPU) — Timer/Counter4 Overflow
46 TIMER5_CAPT (CPU) — Timer/Counter5 Capture Event
47 TIMER5_COMPA (CPU) — Timer/Counter5 Compare Match A
48 TIMER5_COMPB (CPU) — Timer/Counter5 Compare Match B
49 TIMER5_COMPC (CPU) — Timer/Counter5 Compare Match C
50 TIMER5_OVF (CPU) — Timer/Counter5 Overflow
57 TRX24_PLL_LOCK (CPU) — TRX24 - PLL lock interrupt
58 TRX24_PLL_UNLOCK (CPU) — TRX24 - PLL unlock interrupt
59 TRX24_RX_START (CPU) — TRX24 - Receive start interrupt
60 TRX24_RX_END (CPU) — TRX24 - RX_END interrupt
61 TRX24_CCA_ED_DONE (CPU) — TRX24 - CCA/ED done interrupt
62 TRX24_XAH_AMI (CPU)
63 TRX24_TX_END (CPU) — TRX24 - TX_END interrupt
64 TRX24_AWAKE (CPU) — TRX24 AWAKE - transceiver is reaching state TRX_OFF
65 SCNT_CMP1 (CPU) — Symbol counter - compare match 1 interrupt
66 SCNT_CMP2 (CPU) — Symbol counter - compare match 2 interrupt
67 SCNT_CMP3 (CPU) — Symbol counter - compare match 3 interrupt
68 SCNT_OVFL (CPU) — Symbol counter - overflow interrupt
69 SCNT_BACKOFF (CPU) — Symbol counter - backoff interrupt
70 AES_READY (CPU) — AES engine ready interrupt
71 BAT_LOW (CPU) — Battery monitor indicates supply voltage below threshold
72 TRX24_TX_START (CPU) — TRX24 TX start interrupt
73 TRX24_AMI0 (CPU) — Address match interrupt of address filter 0
74 TRX24_AMI1 (CPU) — Address match interrupt of address filter 1
75 TRX24_AMI2 (CPU) — Address match interrupt of address filter 2
76 TRX24_AMI3 (CPU) — Address match interrupt of address filter 3
